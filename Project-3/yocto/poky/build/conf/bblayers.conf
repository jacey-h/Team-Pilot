## Project-3/yocto/poky/build/conf/bblayers.conf
```bitbake
# POKY_BBLAYERS_CONF_VERSION is increased each time build/conf/bblayers.conf
# changes incompatibly
POKY_BBLAYERS_CONF_VERSION = "2"

BBPATH = "${TOPDIR}"
BBFILES ?= ""

BBLAYERS ?= " \
  /home/seame-two/yocto/poky/meta \
  /home/seame-two/yocto/poky/meta-poky \
  /home/seame-two/yocto/poky/meta-yocto-bsp \
  /home/seame-two/yocto/poky/meta-raspberrypi \
  /home/seame-two/yocto/poky/meta-openembedded/meta-oe \
  /home/seame-two/yocto/poky/meta-openembedded/meta-multimedia \
  /home/seame-two/yocto/poky/meta-openembedded/meta-networking \
  /home/seame-two/yocto/poky/meta-openembedded/meta-perl \
  /home/seame-two/yocto/poky/meta-openembedded/meta-python \
  /home/seame-two/yocto/poky/meta-ivi/meta-ivi \
  /home/seame-two/yocto/poky/meta-ivi/meta-ivi-bsp \
  /home/seame-two/yocto/poky/meta-jacey \
  /home/seame-two/yocto/poky/meta-qt5 \ 
  /home/seame-two/yocto/poky/meta-iota/meta-tangle \ 
  /home/seame-two/yocto/poky/meta-rust \ 
  /home/seame-two/yocto/poky/meta-splash \ 
  "
BBLAYERS_NON_REMOVABLE ?= " \
  /home/seame-two/yocto/poky/meta \
  /home/seame-two/yocto/poky/meta-poky \
  /home/seame-two/yocto/poky/meta-ivi/meta-ivi \
  "
```

## Project-3/yocto/poky/meta-jacey/conf/layer.conf
```bitbake
# We have a conf and classes directory, add to BBPATH
BBPATH .= ":${LAYERDIR}"

# We have recipes-* directories, add to BBFILES
BBFILES += "${LAYERDIR}/recipes-*/*/*.bb \
            ${LAYERDIR}/recipes-*/*/*.bbappend"

BBFILE_COLLECTIONS += "meta-jacey"
BBFILE_PATTERN_meta-jacey = "^${LAYERDIR}/"
BBFILE_PRIORITY_meta-jacey = "10"

LAYERDEPENDS_meta-jacey = "core"
LAYERSERIES_COMPAT_meta-jacey = "kirkstone"
```

## Project-3/yocto/poky/vscode-bitbake-build/conf/bblayers.conf
```bitbake
# POKY_BBLAYERS_CONF_VERSION is increased each time build/conf/bblayers.conf
# changes incompatibly
POKY_BBLAYERS_CONF_VERSION = "2"

BBPATH = "${TOPDIR}"
BBFILES ?= ""

BBLAYERS ?= " \
  /home/seame-two/yocto/poky/meta \
  /home/seame-two/yocto/poky/meta-poky \
  /home/seame-two/yocto/poky/meta-yocto-bsp \
  "
```
